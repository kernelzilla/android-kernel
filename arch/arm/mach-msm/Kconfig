## drivers/gpu/pvr/Kconfig
```kconfig
config SGX
	tristate "PowerVR SGX"
	---help---
	  Support for the PowerVR SGX 3D core.

choice
	prompt "PowerVR build type"
	depends on SGX
	default SGX_BUILD_RELEASE

config SGX_BUILD_RELEASE
       bool "RELEASE"

config SGX_BUILD_DEBUG
       bool "DEBUG"

endchoice

config SGX_RELEASE_LOGGING
       bool "Error logging in release build"
       ---help---
          Includes error logging in release build

config SGX_EDM_TRACING
       bool "EDM Status Tracing"
       ---help---
         Enable EDM status trace dumping on HW Recovery

config SGX_MK_TRACE
       bool "MK Trace"
       ---help---
         Enable suppport for dumping EDM status tracing from userspace
	
config PVR_OMAPLFB
	tristate "PowerVR OMAP buffer class"
	depends on SGX
	---help---
	  Support for the OMAP frame buffer in PowerVR.

config PVR_OMAP_DSS2
	depends on SGX && PVR_OMAPLFB
	tristate "PowerVR OMAP dss2"
	depends on SGX
	---help---
	  Support for the OMAP dss2 frame buffer in PowerVR.

config PVR_OMAP_USE_VSYNC
	tristate "PowerVR OMAP use vsync"
	depends on SGX
	---help---
	  Support for the OMAP vsync interrupt in PowerVR.

config PVR_APM
	tristate "Enable PowerVR Active Power Managemt"
	depends on SGX
	---help---
	   Enable PowerVR Active Power Managemt
```

## drivers/haptic/Kconfig
```kconfig
menuconfig HAPTIC
	bool "Haptic support"
	help
	  Say Y to enable haptic support. It enables the haptic and controls
	  from userspace.

if HAPTIC

config HAPTIC_CLASS
	tristate "Haptic Class Support"
	help
	  This option enables the haptic sysfs class in /sys/class/haptic.

comment "Haptic drivers"

config HAPTIC_ISA1200
	tristate "ISA1200 haptic support"
	depends on HAPTIC_CLASS && I2C
	help
	  The ISA1200 is a high performance enhanced haptic driver.

endif	# HAPTIC
```

## drivers/i2c/chips/Kconfig
```kconfig
#
# Miscellaneous I2C chip drivers configuration
#
# *** DEPRECATED! Do not add new entries! See Makefile ***
#

menu "Miscellaneous I2C Chip support"

config SENSORS_MT9T013
	tristate "MT9T013 Camera Driver"
	depends on I2C
	default y
	help
	 MT9T013 Camera Driver implemented by HTC.

config SENSORS_PCA963X
        tristate "Philips PCA963X 4-bit I2C-bus LED"
        depends on I2C && EXPERIMENTAL
        help
         If you say yes here you get support for the Philips PCA963X
         4-bit I2C-bus LED.

         This driver can also be built as a module.  If so, the module
         will be called pca963X.

endmenu
```

## drivers/input/opticaljoystick/Kconfig.old
```kconfig
#
# Touchscreen driver configuration
#
config INPUT_OPTICALJOYSTICK
	bool "Opticaljoystick"
	help
	  Say Y here, and a list of supported optical joystick will be displayed.
	  This option doesn't affect the kernel.

	  If unsure, say Y.

config OPTICALJOYSTICK_CRUCIAL
	bool
	depends on INPUT_OPTICALJOYSTICK
	default OPTICALJOYSTICK_CRUCIAL_uP

choice
	prompt "Interface"

config OPTICALJOYSTICK_CRUCIAL_uP
	bool "Crucial Optical Joystick (microP)"
	depends on MICROP_COMMON
	select OPTICALJOYSTICK_CRUCIAL
	help

config OPTICALJOYSTICK_CRUCIAL_SPI
	bool "Crucial Optical Joystick (SPI)"
	depends on SPI_CRUCIAL_OJ
	select OPTICALJOYSTICK_CRUCIAL
	help

endchoice
```

## drivers/media/IR/Kconfig
```kconfig
config IR_CORE
	tristate "Core IR support"
	depends on INPUT
	default INPUT

config VIDEO_IR
	tristate
	depends on IR_CORE
	default IR_CORE
```

## drivers/media/dvb/siano/Kconfig
```kconfig
#
# Siano Mobile Silicon Digital TV device configuration
#

# w21558, SPI interface between OMAP and SMS1130
config MOT_FEAT_SPI_SMS1130
	bool "Siano and OMAP SPI interface support"
	default n

config SMS_SIANO_MDTV_TDMB
	tristate "Siano SMS1xxx based MDTV receiver"
	default n
	---help---
	Choose Y or M here if you have MDTV receiver with a Siano chipset.
	To compile this driver as a module, choose M here
	(The modules will be called smsmdtv).
	Note: All dependents, if selected, will be part of this module.
	Further documentation on this driver can be found on the WWW at http://www.siano-ms.com/

if SMS_SIANO_MDTV_TDMB
menu "Siano module components"

# Kernel sub systems support

config SMS_DVB3_SUBSYS
	bool "DVB v.3 Subsystem support"
	default n
	---help---
	Choose

config SMS_HOSTLIB_SUBSYS
	bool "Host Library Subsystem support."
	default n
	---help---
	Choose if you would like to have Siano's host library kernel sub-system support.

if SMS_HOSTLIB_SUBSYS

config SMS_NET_SUBSYS
	bool "Siano Network Adapter"
	default n
	---help---
	Choose if you would like to have Siano's network adapter support.

endif # SMS_HOSTLIB_SUBSYS

# Hardware interfaces support

config SMS_SPI_DRV
	bool "SPI interface support"
	default n
	---help---
	Choose if you would like to have Siano's support for OMAP34XX SPI interface

config SMS_USB_DRV
        bool "USB inteface support"
        default n
        ---help---
        Choose

config SMS_SDIO_DRV
        bool "SDIO interface support"
        default n
        ---help---
        Choose

endmenu
endif # SMS_SIANO_MDTV_TDMB
```

## drivers/media/video/msm/Kconfig
```kconfig
comment "Camera Sensor Selection"
config MT9T013
	bool "Sensor mt9t013 (BAYER 3M)"
	depends on MSM_CAMERA
	default n
	---help---
	  MICRON 3M Bayer Sensor with AutoFocus

config MT9D112
	bool "Sensor mt9d112 (YUV 2M)"
	depends on MSM_CAMERA
	default n
	---help---
	  MICRON 2M YUV Sensor

config MT9P012
	bool "Sensor mt9p012 (BAYER 5M)"
	depends on MSM_CAMERA
	default n
	---help---
	  MICRON 5M Bayer Sensor with Autofocus

choice
	prompt "AF module"
	depends on MT9P012
	default MSM_CAMERA_AF_FOXCONN

config MSM_CAMERA_AF_FOXCONN
	bool "FOXCONN Module"
	help
	  This driver supports FOXCONN AF module for 5M Bayer sensor

config MSM_CAMERA_AF_BAM
	bool "BAM Module"
	help
	  This driver supports BAM AF module for 5M Bayer sensor

config MSM_CAMERA_AF_KM
	bool "KM Module"
	help
	  This driver supports KM AF module for 5M Bayer sensor

endchoice

config S5K3E2FX
	bool "Sensor s5k3e2fx (Samsung 5M)"
	depends on MSM_CAMERA
	default n
	---help---
	  Samsung 5M with Autofocus

config VB6801
	bool "Sensor vb6801"
	depends on MSM_CAMERA
	---help---
	  5M with flash

config MSM_CAMERA_FLASH
	bool "Qualcomm MSM camera flash support"
	depends on MSM_CAMERA
	default y
	---help---
	  Enable support for LED flash for msm camera
```

## drivers/media/video/omap/Kconfig
```kconfig
config VIDEO_OMAP_VIDEOLIB
	tristate "OMAP Video out library"
	depends on VIDEO_OMAP3_V4L2
	default VIDEO_OMAP3_V4L2

config VIDEO_OMAP_VIDEOOUT
	tristate "OMAP Video out driver"
	select VIDEOBUF_DMA_SG
	select VIDEOBUF_GEN
	depends on VIDEO_OMAP3_V4L2
	default VIDEO_OMAP3_V4L2

choice
        prompt "TV Mode"
        default NTSC_M

config NTSC_M
        bool "Use NTSC_M mode"
        help
          Select this option if you want NTSC_M mode on TV

config PAL_BDGHI
        bool "Use PAL_BDGHI mode"
        help
          Select this option if you want PAL_BDGHI mode on TV

endchoice
```

## drivers/misc/netmux/Kconfig
```kconfig
#
# Netmux configuration
#

menu "Motorola netmux driver"

config NETMUX_DRIVER
        tristate "Motorola netmux driver"
        default m

endmenu
```

## drivers/misc/sec/Kconfig
```kconfig
#
# Sec configuration
#

menu "Motorola sec driver"

config SEC_DRIVER
	tristate "Motorola sec driver"
	default n

endmenu
```

## drivers/net/wireless/tiwlan1251/Kconfig
```kconfig
config TIWLAN1251
        bool "TIWLAN1251 WiFi Module"
        default n
        depends on m
```

## drivers/video/omap2/displays/Kconfig
```kconfig
menu "OMAP2/3 Display Device Drivers"
        depends on OMAP2_DSS

config PANEL_GENERIC
        tristate "Generic Panel"
        help
	  Generic panel driver.
	  Used for DVI output for Beagle and OMAP3 SDP.

config PANEL_SAMSUNG_LTE430WQ_F0C
        tristate "Samsung LTE430WQ-F0C LCD Panel"
        depends on OMAP2_DSS
        help
          LCD Panel used on Overo Palo43

config PANEL_SHARP_LS037V7DW01
        tristate "Sharp LS037V7DW01 LCD Panel"
        depends on OMAP2_DSS
        help
          LCD Panel used in TI's SDP3430 and EVM boards

config PANEL_N800
        tristate "Panel N8x0"
        help
          N8x0 LCD (hack)

config PANEL_ZOOM2
        tristate "TI Zoom2 Panel"
        help
          LCD Panel used in the TI Zoom2

config CTRL_BLIZZARD
        tristate "Blizzard Controller"
        help
          Blizzard Controller (hack)

config PANEL_ACX565AKM
        tristate "ACX565AKM LCD Panel"
        depends on OMAP2_DSS_SDI
        select BACKLIGHT_CLASS_DEVICE
        help
          LCD Panel used in RX51

config CTRL_EDISCO
        tristate "Edisco Controller"
        help
          Toshiba EDISCO Controller

config PANEL_SHOLES
        tristate "Sholes Panel"
        help
	  LCD Panel used in sholes

endmenu
```

## fs/aufs/Kconfig
```kconfig
config AUFS_FS
	bool "Aufs (Advanced multi layered unification filesystem) support"
	depends on EXPERIMENTAL
	help
	Aufs is a stackable unification filesystem such as Unionfs,
	which unifies several directories and provides a merged single
	directory.
	In the early days, aufs was entirely re-designed and
	re-implemented Unionfs Version 1.x series. Introducing many
	original ideas, approaches and improvements, it becomes totally
	different from Unionfs while keeping the basic features.

if AUFS_FS
choice
	prompt "Maximum number of branches"
	default AUFS_BRANCH_MAX_127
	help
	Specifies the maximum number of branches (or member directories)
	in a single aufs. The larger value consumes more system
	resources and has a minor impact to performance.
config AUFS_BRANCH_MAX_127
	bool "127"
	help
	Specifies the maximum number of branches (or member directories)
	in a single aufs. The larger value consumes more system
	resources and has a minor impact to performance.
config AUFS_BRANCH_MAX_511
	bool "511"
	help
	Specifies the maximum number of branches (or member directories)
	in a single aufs. The larger value consumes more system
	resources and has a minor impact to performance.
config AUFS_BRANCH_MAX_1023
	bool "1023"
	help
	Specifies the maximum number of branches (or member directories)
	in a single aufs. The larger value consumes more system
	resources and has a minor impact to performance.
config AUFS_BRANCH_MAX_32767
	bool "32767"
	help
	Specifies the maximum number of branches (or member directories)
	in a single aufs. The larger value consumes more system
	resources and has a minor impact to performance.
endchoice

config AUFS_HINOTIFY
	bool "Use inotify to detect actions on a branch"
	depends on INOTIFY
	help
	If you want to modify files on branches directly, eg. bypassing aufs,
	and want aufs to detect the changes of them fully, then enable this
	option and use 'udba=inotify' mount option.
	It will have a negative impact to the performance.
	See detail in aufs.5.

config AUFS_EXPORT
	bool "NFS-exportable aufs"
	depends on EXPORTFS = y
	help
	If you want to export your mounted aufs via NFS, then enable this
	option. There are several requirements for this configuration.
	See detail in aufs.5.

config AUFS_DEBUG
	bool "Debug aufs"
	help
	Enable this to compile aufs internal debug code.
	It will have a negative impact to the performance.

config AUFS_MAGIC_SYSRQ
	bool
	depends on AUFS_DEBUG && MAGIC_SYSRQ
	default y
	help
	Automatic configuration for internal use.
	When aufs supports Magic SysRq, enabled automatically.

config AUFS_BDEV_LOOP
	bool
	depends on BLK_DEV_LOOP
	default y
	help
	Automatic configuration for internal use.
	Convert =[ym] into =y.

config AUFS_INO_T_64
	bool
	depends on 64BIT && !(ALPHA || S390)
	default y
	help
	Automatic configuration for internal use.
	/* typedef unsigned long/int __kernel_ino_t */
	/* alpha and s390x are int */
endif
```

## kernel/Kconfig.lttlite
```kconfig
menu "LTT-Lite (Linux Tracing Tool)"
config LTT_LITE
		bool "Lite version of the Linux Trace Toolkit support"
		depends on !LTT
		default n
		help
				provide a scaled-down version of LTT: logs only some
				of the events;
				logs them to a file rather than to relayfs;
				does not require a user-space daemon.
endmenu
```

## kernel/gcov/Kconfig
```kconfig
#
# GCOV coverage profiling
#

menu "GCOV coverage profiling"

config GCOV_PROFILE
	bool "Include GCOV coverage profiling"
	---help---
        Provide infrastructure for GCOV kernel coverage support.

        Enable GCOV_ALL to get coverage data for the entire kernel
        source.

        To get coverage data for only specific files or directories,
        add the following line to the respective Makefile:

                EXTRA_CFLAGS += $(GCOV_FLAGS)

        Note that GCOV_PROC has to be enabled to access GCOV kernel
        coverage data.

config GCOV_ALL
	bool "Profile entire Kernel"
	depends on GCOV_PROFILE
	---help---
	If you say Y here, it will compile the entire kernel with coverage
	option enabled.

config GCOV_PROC
	tristate "Provide GCOV proc file system entry"
	depends on GCOV_PROFILE && PROC_FS
	---help---
        Install a proc file system entry at /proc/gcov which provides
        access to the current coverage state of the kernel code.

        This option is also available as a module called gcov-proc.o.
        It can be loaded using:

          modprobe gcov-proc

config GCOV_HAMMER
	bool "Support for modified GCC version 3.3.x (hammer patch)"
	depends on GCOV_PROFILE
	---help---
	Some Linux distributions ship a modified version of GCC 3.3.x that
	produces GCOV data incompatible with the format of the standard
	GCC 3.3.x. If you are using such a distribution, you need to enable
	this option for the GCOV kernel support to work correctly.

	Distributions known to include this modification:
		SUSE SLES9
		Mandrake Linux 10.x

endmenu
```

## sound/soc/msm/Kconfig
```kconfig
menu "SoC Audio support Qualcomm"

config SND_MSM_SOC
	tristate "SoC Audio for the MSM chip"
	depends on ARCH_MSM && SND_SOC
	select MSM_ADSP
	help
	  To add support for ALSA PCM driver for MSM7k board.

config SND_QSD_SOC
	tristate "SoC Audio for the QSD chip"
	depends on ARCH_QSD && SND_SOC && QSD_AUDIO
	default y
	help
	  To add support for ALSA PCM driver for QSD8k board.

endmenu
```
